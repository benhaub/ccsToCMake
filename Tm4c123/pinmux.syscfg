/**
 * These arguments were used when this file was generated. They will be automatically applied on subsequent loads
 * via the GUI or CLI. Run CLI with '--help' for additional information on how to override these arguments.
 * @cliArgs --device "TM4C123x" --package "64 Pin QFP|16x16" --part "TM4C123GH6PM"
 * @versions {"tool":"1.20.0+3587"}
 */

/**
 * These are the peripherals and settings in this configuration
 */
const iUART1 = scripting.addPeripheral("UART");
iUART1.$name = "UART1";

/**
 * Pinmux solution for unlocked pins/peripherals. This ensures that minor changes to the automatic solver in a future
 * version of the tool will not impact the pinmux you originally saw.  These lines can be completely deleted in order to
 * re-solve from scratch.
 */
iUART1.$suggestSolution     = "UART1";
iUART1.RX.$suggestSolution  = "PB0";
iUART1.RTS.$suggestSolution = "PC4";
iUART1.TX.$suggestSolution  = "PB1";
iUART1.CTS.$suggestSolution = "PC5";
